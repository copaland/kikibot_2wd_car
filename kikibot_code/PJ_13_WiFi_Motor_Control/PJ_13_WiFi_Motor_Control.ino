// generated by KidsBlock
#include <Arduino.h>
#include <WiFi.h>
#include <ESPmDNS.h>
#include <WiFiClient.h>


String item = "0";

const char* ssid = "copaland";
const char* password = "24868080";
WiFiServer server(80);


void setup() {
  Serial.begin(115200);
   WiFi.begin(ssid, password);
   while (WiFi.status() != WL_CONNECTED) {
   delay(500);
   Serial.print(".");
    }
    Serial.println("");
    Serial.print("Connected to ");
    Serial.println(ssid);
    Serial.print("IP address: ");
    Serial.println(WiFi.localIP());
    server.begin();
    Serial.println("TCP server started");
    MDNS.addService("http", "tcp", 80);

  pinMode(33, OUTPUT);
  ledcSetup(1, 1200, 8);
  ledcAttachPin(25, 1);

  pinMode(27, OUTPUT);
  ledcSetup(2, 1200, 8);
   ledcAttachPin(14, 2);

  pinMode(32, OUTPUT);
  pinMode(26, OUTPUT);
  digitalWrite(32, HIGH);
  digitalWrite(26, HIGH);
  pinMode(4, OUTPUT);
  pinMode(13, OUTPUT);
  digitalWrite(4, HIGH);
}

void loop() {
  WiFiClient client = server.available();
      if (!client) {
          return;
      }
      while(client.connected() && !client.available()){
          delay(1);
      }
      String req = client.readStringUntil('\r');
      int addr_start = req.indexOf(' ');
      int addr_end = req.indexOf(' ', addr_start + 1);
      if (addr_start == -1 || addr_end == -1) {
          Serial.print("Invalid request: ");
          Serial.println(req);
          return;
      }
  req = req.substring(addr_start + 1, addr_end);
  item=req;
  Serial.println(item);
  if (item == "/btn/S") {
    digitalWrite(33,LOW);
    ledcWrite(1, 0);
    digitalWrite(27,LOW);
    ledcWrite(2, 0);
  }
  if (item == "/btn/F") {
    digitalWrite(33,LOW);
    ledcWrite(1, 200);
    digitalWrite(27,LOW);
    ledcWrite(2, 200);
  }
  if (item == "/btn/B") {
    digitalWrite(33,HIGH);
    ledcWrite(1, 55);
    digitalWrite(27,HIGH);
    ledcWrite(2, 55);
  }
  if (item == "/btn/L") {
    digitalWrite(33,LOW);
    ledcWrite(1, 160);
    digitalWrite(27,LOW);
    ledcWrite(2, 200);
  }
  if (item == "/btn/R") {
    digitalWrite(33,LOW);
    ledcWrite(1, 200);
    digitalWrite(27,LOW);
    ledcWrite(2, 160);
  }
  if (item == "/btn/q") {
    digitalWrite(33,HIGH);
    ledcWrite(1, 55);
    digitalWrite(27,LOW);
    ledcWrite(2, 200);
  }
  if (item == "/btn/p") {
    digitalWrite(33,LOW);
    ledcWrite(1, 200);
    digitalWrite(27,HIGH);
    ledcWrite(2, 55);
  }
  if (item == "/btn/x") {
    digitalWrite(33,LOW);
    ledcWrite(1, 0);
    digitalWrite(27,LOW);
    ledcWrite(2, 0);
  }
}
