// generated by KidsBlock
#include <Arduino.h>

#include <Arduino.h>
#include <WiFi.h>
#if defined(ESP32)
#include <AsyncTCP.h>
#elif defined(ESP8266)
#include <ESPAsyncTCP.h>
#endif

#include <ESPAsyncWebServer.h>
#include <WebSerial.h>
AsyncWebServer server(80);
String web_rcv = "0";

void recvMsg(uint8_t *data, size_t len){
String web_data = "";
 for(int i=0; i < len; i++){
  web_data += char(data[i]);
}
WebSerial.println(String(web_data));
  web_rcv=web_data;
}


void setup() {
  WebSerial.begin(&server);
    WebSerial.msgCallback(recvMsg);
    server.begin();
    Serial.print(WiFi.localIP());
    Serial.println("/webserial");
  pinMode(13, OUTPUT);
  digitalWrite(13, LOW);
}

void loop() {
  if (web_rcv == "/btn/1") {
    digitalWrite(13, HIGH);
  }
  if (web_rcv == "/btn/0") {
    digitalWrite(13, LOW);
  }
}
