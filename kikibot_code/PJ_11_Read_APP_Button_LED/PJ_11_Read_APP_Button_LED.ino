// generated by KidsBlock
#include <Arduino.h>
#include <WiFi.h>
#include <ESPmDNS.h>
#include <WiFiClient.h>


String item = "0";

const char* ssid = "copaland";
const char* password = "24868080";
WiFiServer server(80);


void setup() {
  Serial.begin(115200);
   WiFi.begin(ssid, password);
   while (WiFi.status() != WL_CONNECTED) {
   delay(500);
   Serial.print(".");
    }
    Serial.println("");
    Serial.print("Connected to ");
    Serial.println(ssid);
    Serial.print("IP address: ");
    Serial.println(WiFi.localIP());
    server.begin();
    Serial.println("TCP server started");
    MDNS.addService("http", "tcp", 80);

  pinMode(4, OUTPUT);
  digitalWrite(4, LOW);
}

void loop() {
  WiFiClient client = server.available();
      if (!client) {
          return;
      }
      while(client.connected() && !client.available()){
          delay(1);
      }
      String req = client.readStringUntil('\r');
      int addr_start = req.indexOf(' ');
      int addr_end = req.indexOf(' ', addr_start + 1);
      if (addr_start == -1 || addr_end == -1) {
          Serial.print("Invalid request: ");
          Serial.println(req);
          return;
      }
  req = req.substring(addr_start + 1, addr_end);
  item=req;
  Serial.println(item);
  if (item == /btn/1) {
    digitalWrite(4, HIGH);
  }
  if (item == /btn/0) {
    digitalWrite(4, LOW);
  }
}
